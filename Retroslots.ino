#include <stdlib.h>
#include <stdio.h>
#include <Wire.h>
#include <Adafruit_GFX.h>
#include <Adafruit_SSD1306.h>

#define SCREEN_WIDTH 128 
#define SCREEN_HEIGHT 64

#define OLED_RESET     -1 
#define SCREEN_ADDRESS 0x3C 
Adafruit_SSD1306 display(SCREEN_WIDTH, SCREEN_HEIGHT, &Wire, OLED_RESET);

static const unsigned char PROGMEM BLACKSCREEN[] = {
	0x00, 0x00, 0x00, 0x00, 0x00, 0x00, 0x00, 0x00, 0x00, 0x00, 0x00, 0x00, 0x00, 0x00, 0x00, 0x00, 
	0x00, 0x00, 0x00, 0x00, 0x00, 0x00, 0x00, 0x00, 0x00, 0x00, 0x00, 0x00, 0x00, 0x00, 0x00, 0x00, 
	0x00, 0x00, 0x00, 0x00, 0x00, 0x00, 0x00, 0x00, 0x00, 0x00, 0x00, 0x00, 0x00, 0x00, 0x00, 0x00, 
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	0x00, 0x00, 0x00, 0x00, 0x00, 0x00, 0x00, 0x00, 0x00, 0x00, 0x00, 0x00, 0x00, 0x00, 0x00, 0x00
};

static const unsigned char PROGMEM SEPTAR[] = {
	0x00, 0x00, 0x00, 0x00, 0x00, 0x00, 0x00, 0x00, 0x00, 0x00, 0x00, 0x00, 0x00, 0x00, 0x00, 0x00, 
	0x00, 0x00, 0x00, 0x00, 0x00, 0x00, 0x00, 0x00, 0x00, 0x00, 0x00, 0x00, 0x00, 0x00, 0x00, 0x00, 
	0x00, 0x00, 0x00, 0x00, 0x00, 0x00, 0x00, 0x00, 0x00, 0x00, 0x00, 0x00, 0x00, 0x00, 0x00, 0x00, 
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	0x00, 0x00, 0x00, 0x00, 0x00, 0x00, 0x00, 0x00, 0x00, 0x00, 0x00, 0x00, 0x00, 0x00, 0x00, 0x00
};

static const unsigned char PROGMEM SAPTEMIC[] = {
	0x00, 0x00, 0x00, 0x00, 0x00, 0x00, 0x00, 0x00, 0x00, 0x00, 0x00, 0x00, 0x00, 0x00, 0x00, 0x00, 
	0x00, 0x00, 0x00, 0x00, 0x00, 0x00, 0x00, 0x00, 0x00, 0x00, 0x00, 0x00, 0x00, 0x00, 0x00, 0x00, 
	0x00, 0x00, 0x00, 0x00, 0x00, 0x1f, 0x00, 0x70, 0x0f, 0xe0, 0xf8, 0xd8, 0x0a, 0x9f, 0x8f, 0x50, 
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	0x00, 0x00, 0x00, 0x00, 0x00, 0x00, 0x00, 0x00, 0x00, 0x00, 0x00, 0x00, 0x00, 0x00, 0x00, 0x00
};

static const unsigned char PROGMEM CIREASA[] = {
	0x00, 0x00, 0x00, 0x00, 0x00, 0x00, 0x00, 0x00, 0x00, 0x00, 0x00, 0x00, 0x00, 0x00, 0x00, 0x00, 
	0x00, 0x00, 0x00, 0x00, 0x00, 0x00, 0x00, 0x00, 0x00, 0x00, 0x00, 0x00, 0x00, 0x00, 0x00, 0x00, 
	0x00, 0x07, 0x00, 0x00, 0x00, 0x0f, 0x88, 0x00, 0x00, 0x1f, 0xd8, 0x00, 0x00, 0x07, 0xf0, 0x00, 
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	0x00, 0x00, 0x00, 0x00, 0x00, 0x00, 0x00, 0x00, 0x00, 0x00, 0x00, 0x00, 0x00, 0x00, 0x00, 0x00
};

static const unsigned char PROGMEM LAMAIE[] = {
	0x00, 0x00, 0x00, 0x00, 0x00, 0x00, 0x00, 0x00, 0x00, 0x00, 0x00, 0x00, 0x00, 0x00, 0x00, 0x00, 
	0x00, 0x00, 0x00, 0x00, 0x00, 0x00, 0x00, 0x00, 0x00, 0x00, 0x00, 0x00, 0x00, 0x00, 0x00, 0x00, 
	0x00, 0x03, 0xc4, 0x00, 0x00, 0x07, 0xe4, 0x00, 0x00, 0x07, 0xf4, 0x00, 0x00, 0x03, 0xec, 0x00, 
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	0x00, 0x00, 0x00, 0x00, 0x00, 0x00, 0x00, 0x00, 0x00, 0x00, 0x00, 0x00, 0x00, 0x00, 0x00, 0x00
};

static const unsigned char PROGMEM STRUGURE[] = {
	0x00, 0x00, 0x00, 0x00, 0x00, 0x00, 0x00, 0x00, 0x00, 0x00, 0x00, 0x00, 0x00, 0x00, 0x00, 0x00, 
	0x00, 0x00, 0x00, 0x00, 0x00, 0x00, 0x00, 0x00, 0x00, 0x00, 0x00, 0x00, 0x00, 0x00, 0x00, 0x00, 
	0x00, 0x03, 0xc4, 0x00, 0x00, 0x07, 0xe8, 0x00, 0x00, 0x01, 0xf8, 0x00, 0x00, 0x00, 0xd0, 0x00, 
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	0x00, 0x00, 0x00, 0x00, 0x00, 0x00, 0x00, 0x00, 0x00, 0x00, 0x00, 0x00, 0x00, 0x00, 0x00, 0x00
};

static const unsigned char PROGMEM DIAMANT[] = {
	0x00, 0x00, 0x00, 0x00, 0x00, 0x00, 0x00, 0x00, 0x00, 0x00, 0x00, 0x00, 0x00, 0x00, 0x00, 0x00, 
	0x00, 0x00, 0x00, 0x00, 0x00, 0x00, 0x00, 0x00, 0x00, 0x00, 0x00, 0x00, 0x00, 0x00, 0x00, 0x00, 
	0x00, 0x00, 0x00, 0x00, 0x00, 0x00, 0x00, 0x00, 0x00, 0x00, 0x00, 0x00, 0x00, 0x00, 0x00, 0x00, 
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	0x00, 0x00, 0x00, 0x00, 0x00, 0x00, 0x00, 0x00, 0x00, 0x00, 0x00, 0x00, 0x00, 0x00, 0x00, 0x00
};

static const unsigned char PROGMEM ROSU[] = {
  0x00, 0x00, 0x00, 0x00, 0x00, 0x00, 0x00, 0x00, 0x00, 0x00, 0x00, 0x00, 0x00, 0x00, 0x00, 0x00, 
	0x00, 0x00, 0x00, 0x00, 0x00, 0x00, 0x00, 0x00, 0x00, 0x00, 0x00, 0x00, 0x00, 0x00, 0x00, 0x00, 
	0x00, 0x0f, 0xff, 0xff, 0xff, 0xff, 0xf0, 0x00, 0x00, 0x0c, 0x00, 0x00, 0x00, 0x00, 0x30, 0x00, 
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	0x00, 0x00, 0x00, 0x00, 0x00, 0x00, 0x00, 0x00, 0x00, 0x00, 0x00, 0x00, 0x00, 0x00, 0x00, 0x00
};

static const unsigned char PROGMEM ALBASTRU[] = {
	0x00, 0x00, 0x00, 0x00, 0x00, 0x00, 0x00, 0x00, 0x00, 0x00, 0x00, 0x00, 0x00, 0x00, 0x00, 0x00, 
	0x00, 0x00, 0x00, 0x00, 0x00, 0x00, 0x00, 0x00, 0x00, 0x00, 0x00, 0x00, 0x00, 0x00, 0x00, 0x00, 
	0x00, 0x3f, 0xff, 0xff, 0xff, 0xff, 0xfc, 0x00, 0x00, 0x30, 0x00, 0x00, 0x00, 0x00, 0x0c, 0x00, 
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	0x00, 0x00, 0x00, 0x00, 0x00, 0x00, 0x00, 0x00, 0x00, 0x00, 0x00, 0x00, 0x00, 0x00, 0x00, 0x00
};

static const unsigned char PROGMEM CARTE[] = {
	0x00, 0x00, 0x00, 0x00, 0x00, 0x00, 0x00, 0x00, 0x00, 0x00, 0x00, 0x00, 0x00, 0x00, 0x00, 0x00, 
	0x00, 0x07, 0xff, 0xff, 0xff, 0xff, 0xf0, 0x00, 0x00, 0x0f, 0xff, 0xff, 0xff, 0xff, 0xf8, 0x00, 
	0x00, 0x1c, 0x00, 0x00, 0x00, 0x00, 0x38, 0x00, 0x00, 0x1b, 0xbf, 0xff, 0xff, 0xff, 0xd8, 0x00, 
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	0x00, 0x00, 0x00, 0x00, 0x00, 0x00, 0x00, 0x00, 0x00, 0x00, 0x00, 0x00, 0x00, 0x00, 0x00, 0x00
};

  const int butonAlb = 7;
  const int butonRosu = 8;
  const int butonAlbastru = 9;
  const int buzzer = 6;
  const int becRosu = 3;
  const int becVerde = 4;

  int buttonStateAlb = 0;
  int buttonStateRosu = 0;
  int buttonStateAlbastru = 0;
  int credit = 1000;
  int bet = 10;
  int gameStart = 0;


  void black(){
    display.clearDisplay();
    display.drawBitmap(0, 0, BLACKSCREEN, 128, 64, 1);
    display.display();
  }

  void menu(){
  display.clearDisplay();
  display.setTextSize(1);
  display.setTextColor(WHITE);
  display.setCursor(1, 20);
  display.println("Press WHITE to play!");
  display.setCursor(50, 56);
  display.print("Credit: ");
  display.print(credit);
  display.setCursor(0, 56);
  display.print("Bet: ");
  display.print(bet);
  display.display();
  }


  void septar(){
    display.clearDisplay();
    display.drawBitmap(0, 0, SEPTAR, 128, 64, 1);
    display.display();
  }

  void sapte(int x, int y){
    display.drawBitmap(x, y, SAPTEMIC, 32, 48, 1);
    display.display();
    display.setCursor(50, 56);
    display.print("Credit: ");
    display.print(credit);
    display.display();
    display.setCursor(0, 56);
    display.print("Bet: ");
    display.print(bet);
    display.display();
  }

  void cireasa(int x, int y){
    display.drawBitmap(x, y, CIREASA, 32, 48, 1);
    display.display();
    display.setCursor(50, 56);
    display.print("Credit: ");
    display.print(credit);
    display.display();
    display.setCursor(0, 56);
    display.print("Bet: ");
    display.print(bet);
    display.display();
  }

  void lamaie(int x, int y){
    display.drawBitmap(x, y, LAMAIE, 32, 48, 1);
    display.display();
    display.setCursor(50, 56);
    display.print("Credit: ");
    display.print(credit);
    display.display();
    display.setCursor(0, 56);
    display.print("Bet: ");
    display.print(bet);
    display.display();
  }

  void strugure(int x, int y){
    display.drawBitmap(x, y, STRUGURE, 32, 48, 1);
    display.display();
    display.setCursor(50, 56);
    display.print("Credit: ");
    display.print(credit);
    display.display();
    display.setCursor(0, 56);
    display.print("Bet: ");
    display.print(bet);
    display.display();
  }

  void diamant(int x, int y){
    display.drawBitmap(x, y, DIAMANT, 32, 48, 1);
    display.display();
    display.setCursor(50, 56);
    display.print("Credit: ");
    display.print(credit);
    display.display();
    display.setCursor(0, 56);
    display.print("Bet: ");
    display.print(bet);
    display.display();
  }

  int dublaj(int x) {
  delay(200);
  const int maxRunde = 5;

  for (int runda = 0; runda < maxRunde; runda++) {
    int eu = rand() % 100 + 1;
    int house = rand() % 76 + 25;

    display.clearDisplay();
    display.drawBitmap(32, 0, CARTE, 64, 48, 1);
    display.setCursor(40, 52);
    display.print("Win: ");
    display.print(x);
    display.display();

    bool alegereFacuta = false;

    while (!alegereFacuta) {
      buttonStateRosu = digitalRead(butonRosu);
      buttonStateAlbastru = digitalRead(butonAlbastru);
      buttonStateAlb = digitalRead(butonAlb);

      if (buttonStateAlb == HIGH) {
        return x;
      }

      if (buttonStateRosu == HIGH) {
        alegereFacuta = true;
        delay(200);

        if (eu >= house) {
          x *= 2;
          display.clearDisplay();
          display.drawBitmap(32, 0, ROSU, 64, 48, 1);
          display.setCursor(44, 52);
          display.print("Win: ");
          display.print(x);
          display.display();
          digitalWrite(becVerde, HIGH);
          tone(buzzer, 880, 200);
          delay(200);
          tone(buzzer, 988, 200);
          delay(200);
          tone(buzzer, 1047, 200);
          delay(200);
          digitalWrite(becVerde, LOW);
          delay(500);
        } 
        
        else {
          display.clearDisplay();
          display.drawBitmap(32, 0, ALBASTRU, 64, 48, 1);
          display.setCursor(37, 54);
          display.print("YOU LOSE!");
          display.display();
          digitalWrite(becRosu, HIGH);
          tone(buzzer, 392, 300);
          delay(300);
          tone(buzzer, 349, 300);
          delay(300);
          tone(buzzer, 330, 300);
          delay(300);
          digitalWrite(becRosu, LOW);
          delay(300);
          return 0;
        }
      }

      if (buttonStateAlbastru == HIGH) {
        alegereFacuta = true;
        delay(200);

        if (eu >= house) {
          x *= 2;
          display.clearDisplay();
          display.drawBitmap(32, 0, ALBASTRU, 64, 48, 1);
          display.setCursor(44, 52);
          display.print("Win: ");
          display.print(x);
          display.display();
          digitalWrite(becVerde, HIGH);
          tone(buzzer, 880, 200);
          delay(200);
          tone(buzzer, 988, 200);
          delay(200);
          tone(buzzer, 1047, 200);
          delay(200);
          digitalWrite(becVerde, LOW);
          delay(500);
        } 
        
        else {
          display.clearDisplay();
          display.drawBitmap(32, 0, ROSU, 64, 48, 1);
          display.setCursor(37, 54);
          display.print("YOU LOSE!");
          display.display();
          digitalWrite(becRosu, HIGH);
          tone(buzzer, 392, 300);
          delay(300);
          tone(buzzer, 349, 300);
          delay(300);
          tone(buzzer, 330, 300);
          delay(300);
          digitalWrite(becRosu, LOW);
          delay(300);
          return 0;
        }
      }

      delay(50);
    }
  }

  return x;
}

int lose(int credit2){
  display.clearDisplay();
  display.setCursor(37, 20);
  display.println("You lose!");
  display.setCursor(10, 36);
  display.println("WHITE to restart!");
  display.display();

  delay (500);

  while (digitalRead(butonAlb) == LOW) {
    delay(10);
  }
  return credit2 = 1000;
}

void setup() {
  Serial.begin(115200);

  pinMode(butonRosu, INPUT);
  pinMode(butonAlbastru, INPUT);
  pinMode(butonAlb, INPUT);
  pinMode(buzzer, OUTPUT);
  pinMode(becRosu, OUTPUT);
  pinMode(becVerde, OUTPUT);

  if (!display.begin(SSD1306_SWITCHCAPVCC, SCREEN_ADDRESS)) {
    Serial.println(F("SSD1306 allocation failed"));
    for (;;);
  }

  black();
  septar();

  delay(5000);
  display.clearDisplay();
  menu();
}

void loop() {
  buttonStateAlb = digitalRead(butonAlb);
  buttonStateRosu = digitalRead(butonRosu);
  buttonStateAlbastru = digitalRead(butonAlbastru);

  if(gameStart == 0){
    if (buttonStateRosu == HIGH){
      if (bet < 500){
        delay(200);  
        bet += 10;
        display.fillRect(30, 56, 18, 8, BLACK);
        display.setCursor(30, 56);
        display.print(bet);
        display.display();
      }
    }

    else if (buttonStateAlbastru == HIGH){
      if (bet > 10){
        delay(200);  
        bet -= 10;
        display.fillRect(30, 56, 18, 8, BLACK);
        display.setCursor(30, 56);
        display.print(bet);
        display.display();
      }
    }
  }

  if (buttonStateAlb == HIGH && buttonStateRosu == LOW && buttonStateAlbastru == LOW) {
    delay(100);
    gameStart = 1;

    if (credit < bet && buttonStateAlb == HIGH){
      credit = lose(credit);;
      if(buttonStateAlb == HIGH) loop();
    }

    display.clearDisplay();

    int a = rand() % 10 + 1;
    int b = rand() % 10 + 1;
    int c = rand() % 10 + 1;
    int castig = bet;
    credit -= bet;

    if (a == 1) diamant(0, 3);
    else if (a % 5 == 0) strugure(0, 3);
    else if (a % 3 == 0) lamaie(0, 3);
    else if (a % 2 == 0) cireasa(0, 3);
    else if (a == 7) sapte(0, 3);
    delay(1000);

    if (b == 1) diamant(48, 3);
    else if (b % 3 == 0) lamaie(48, 3);
    else if (b % 5 == 0) strugure(48, 3);
    else if (b % 2 == 0) cireasa(48, 3);
    else if (b == 7) sapte(48, 3);
    delay(1000);

    if (c == 1) diamant(96, 3);
    else if (c % 3 == 0) lamaie(96, 3);
    else if (c % 5 == 0) strugure(96, 3);
    else if (c % 2 == 0) cireasa(96, 3);
    else if (c == 7) sapte(96, 3);

    if ((a % 3 == 0) && (b % 3 == 0) && (c % 3 == 0)) castig *= 8;
    else if ((a % 3 == 0) && (b % 3 == 0)) castig *= 3;
    else if ((a % 5 == 0) && (b % 5 == 0) && (c % 5 == 0)) castig *= 10;
    else if ((a % 5 == 0) && (b % 5 == 0)) castig *= 5;
    else if ((a % 2 == 0) && (b % 2 == 0) && (c % 2 == 0)) castig *= 5;
    else if ((a % 2 == 0) && (b % 2 == 0)) castig *= 2;
    else if ((a == 7) && (b == 7) && (c == 7)) castig *= 25;
    else if ((a == 7) && (b == 7)) castig *= 10;
    else if ((a == 1) && (b == 1) && (c == 1)) castig *= 25;
    else if ((a == 1) && (b == 1)) castig *= 10;

    if (castig > bet){
        bool alegereFacuta = false;
        int castigFinal = castig;

        while (!alegereFacuta) {
          buttonStateRosu = digitalRead(butonRosu);
          buttonStateAlbastru = digitalRead(butonAlbastru);
          buttonStateAlb = digitalRead(butonAlb);

          if (buttonStateRosu == HIGH || buttonStateAlbastru == HIGH) {
            alegereFacuta = true;
            castigFinal = dublaj(castig);
            credit += castigFinal;
          }

          else if (buttonStateAlb == HIGH) {
            alegereFacuta = true;
            credit += castig;
          }

          delay(100);
        }
      }
      delay(500);
  }
}